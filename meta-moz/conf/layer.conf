## meta-moz/conf/layer.conf
```bitbake
# conf/layer.conf for the custom meta-moz layer

# Add our layer's path to the places BitBake searches for files
BBPATH .= ":${LAYERDIR}"

# Tell BitBake where to find recipe (.bb) and append (.bbappend) files
# within this layer. The wildcard allows for flexible sub-directory naming.
BBFILES += "${LAYERDIR}/recipes-*/*/*.bb \
            ${LAYERDIR}/recipes-*/*/*.bbappend"

# Define the collection for this layer. This is the short name that will be
# used for dependencies and priorities.
BBFILE_COLLECTIONS += "moz"

# Define the file pattern for the 'moz' collection. This tells BitBake that
# any file found via BBFILES within this layer's directory belongs to 'moz'.
BBFILE_PATTERN_moz = "^${LAYERDIR}/"

# Set the priority for this layer. A higher number gives it higher priority,
# allowing its .bbappend files to override configurations from lower-priority layers.
# We set it to 20 to be higher than most base layers.
BBFILE_PRIORITY_moz = "20"

# Declare the layers that this layer depends on. The build will fail
# if these layers are not also present in bblayers.conf.
LAYERDEPENDS_moz = "core raspberrypi"

# Declare which Yocto release series this layer is compatible with.
# This is a good practice to prevent using the layer with an incompatible Yocto version.
LAYER_SERIES_COMPAT_moz = "scarthgap"
```
